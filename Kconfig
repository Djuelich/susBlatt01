## Kconfig
```kconfig
menu "Basissystem"
	config CPU_FREQUENCY
		int "CPU-Taktfrequenz"
		default 12000000
		help
			CPU-Frequenz in Hz. Der FLL-Multiplikator wird aus diesem Wert berechnet.

	config ASPECTS
		bool "Aspekte verwenden"
		default y
		help
			Aktiviert die Uebersetzung mit AspectC++.
endmenu

menu "Debughilfen"
	config DEBUG_PANIC
		bool "Panik-Anzeige auf dem Display"
		depends on ASPECTS
		default y
		help
			Zeigt auf dem Display der eZ430 Chronos Watch einen Fehlercode an,
			wenn das Betriebssystem abstuerzt.

	config DEBUG_GUARD
		bool "Guard enter/leave-Aufrufe pruefen"
		depends on ASPECTS
		default y
		help
			Zeigt an, ob die Interruptsynchronisation falsch benutzt wird.
endmenu

menu "Funktion"
	config BUTTON_SERVICE
		bool "ButtonService An/Aus"
		default y

	config WECKER
		bool "Wecker An/Aus"
		depends on BUTTON_SERVICE
		default y


	config FUNK
		bool "Funk An/Aus"
		depends on BUTTON_SERVICE
		default y


	config CPU_WATCH
		bool "CPUWatch An/Aus"
		depends on BUTTON_SERVICE
		default y

	config BIZEPS
		bool "Bizeps An/Aus"
		depends on BUTTON_SERVICE
		default y

endmenu
```
